; Zephyr-80 MAME bank/serial IRQ proof ROM
;
; Source format: SDCC/ASxxxx Z80 assembly, assembled with sdasz80.
; This targets the experimental zephyr_banktst MAME machine.  It validates the
; Phase 6 behavioral serial RX IRQ path; it is not a real UART/SIO driver.

	.module banktest_irq
	.optsdcc -mz80

	.area _CODE

	.globl reset

SER_STATUS	= 0x20
SER_DATA	= 0x21
SER_CTRL	= 0x22

ST_TX_READY	= 0x01
ST_RX_READY	= 0x02

CTRL_RX_IRQ	= 0x01
CTRL_ACK	= 0x80

BANK_MID	= 0x11
BANK_HIGH	= 0x12
MID_RAM		= 0x80

RX_INDEX	= 0xc000
RX_DONE		= 0xc001
RX_ERROR	= 0xc002

reset:
	di
	jp	start

	.db	0xff, 0xff, 0xff, 0xff, 0xff, 0xff, 0xff, 0xff
	.db	0xff, 0xff, 0xff, 0xff, 0xff, 0xff, 0xff, 0xff
	.db	0xff, 0xff, 0xff, 0xff, 0xff, 0xff, 0xff, 0xff
	.db	0xff, 0xff, 0xff, 0xff, 0xff, 0xff, 0xff, 0xff
	.db	0xff, 0xff, 0xff, 0xff, 0xff, 0xff, 0xff, 0xff
	.db	0xff, 0xff, 0xff, 0xff, 0xff, 0xff, 0xff, 0xff
	.db	0xff, 0xff, 0xff, 0xff

irq_entry:
	jp	serial_irq_handler

	.db	0xff, 0xff, 0xff, 0xff, 0xff, 0xff, 0xff, 0xff
	.db	0xff, 0xff, 0xff, 0xff, 0xff, 0xff, 0xff, 0xff
	.db	0xff, 0xff, 0xff, 0xff, 0xff, 0xff, 0xff, 0xff
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	.db	0xff, 0xff, 0xff, 0xff, 0xff

start:
	ld	sp, #0xffff
	xor	a, a
	ld	hl, #RX_INDEX
	ld	(hl), a
	ld	hl, #RX_DONE
	ld	(hl), a
	ld	hl, #RX_ERROR
	ld	(hl), a

	ld	hl, #msg_boot
	call	serial_puts

	im	1
	ld	a, #CTRL_RX_IRQ
	out	(#SER_CTRL), a
	ei

main_loop:
	halt
	ld	hl, #RX_DONE
	ld	a, (hl)
	or	a, a
	jr	Z, main_loop

	di
	ld	hl, #RX_ERROR
	ld	a, (hl)
	or	a, a
	jp	NZ, fail

	call	test_high_ram_banks
	call	test_mid_ram_banks

	ld	hl, #msg_pass
	call	serial_puts
	jr	done

fail:
	di
	ld	hl, #msg_fail
	call	serial_puts

done:
	halt
	jr	done

serial_irq_handler:
	push	af
	push	bc
	push	de
	push	hl

	in	a, (#SER_STATUS)
	bit	1, a
	jr	Z, irq_ack

	in	a, (#SER_DATA)
	call	serial_putc
	ld	b, a

	ld	hl, #RX_INDEX
	ld	e, (hl)
	ld	d, #0x00
	ld	hl, #expected
	add	hl, de
	ld	a, b
	cp	(hl)
	jr	NZ, irq_error

	ld	hl, #RX_INDEX
	inc	(hl)
	ld	e, (hl)
	ld	d, #0x00
	ld	hl, #expected
	add	hl, de
	ld	a, (hl)
	or	a, a
	jr	NZ, irq_ack

	ld	a, #0x01
	ld	hl, #RX_DONE
	ld	(hl), a
	jr	irq_ack

irq_error:
	ld	a, #0x01
	ld	hl, #RX_ERROR
	ld	(hl), a
	ld	hl, #RX_DONE
	ld	(hl), a

irq_ack:
	ld	a, #(CTRL_ACK | CTRL_RX_IRQ)
	out	(#SER_CTRL), a
	pop	hl
	pop	de
	pop	bc
	pop	af
	ei
	reti

; A = character to send.
serial_putc:
	push	af
wait_tx:
	in	a, (#SER_STATUS)
	bit	0, a
	jr	Z, wait_tx
	pop	af
	out	(#SER_DATA), a
	ret

; HL = zero-terminated string.
serial_puts:
	ld	a, (hl)
	or	a, a
	ret	Z
	call	serial_putc
	inc	hl
	jr	serial_puts

test_high_ram_banks:
	ld	a, #0x00
	out	(#BANK_HIGH), a
	ld	hl, #0x8000
	ld	(hl), #0x12

	ld	a, #0x01
	out	(#BANK_HIGH), a
	ld	hl, #0x8000
	ld	(hl), #0x34

	ld	a, #0x00
	out	(#BANK_HIGH), a
	ld	hl, #0x8000
	ld	a, (hl)
	cp	#0x12
	jp	NZ, fail

	ld	a, #0x01
	out	(#BANK_HIGH), a
	ld	hl, #0x8000
	ld	a, (hl)
	cp	#0x34
	jp	NZ, fail

	ld	a, #0x00
	out	(#BANK_HIGH), a
	ret

test_mid_ram_banks:
	ld	a, #(MID_RAM + 0x00)
	out	(#BANK_MID), a
	ld	hl, #0x4000
	ld	(hl), #0x56

	ld	a, #(MID_RAM + 0x01)
	out	(#BANK_MID), a
	ld	hl, #0x4000
	ld	(hl), #0x78

	ld	a, #(MID_RAM + 0x00)
	out	(#BANK_MID), a
	ld	hl, #0x4000
	ld	a, (hl)
	cp	#0x56
	jp	NZ, fail

	ld	a, #(MID_RAM + 0x01)
	out	(#BANK_MID), a
	ld	hl, #0x4000
	ld	a, (hl)
	cp	#0x78
	jp	NZ, fail

	ld	a, #0x01
	out	(#BANK_MID), a
	ret

msg_boot:
	.ascii	"Serial IRQ test start"
	.db	0x0d, 0x0a, 0x00

msg_pass:
	.db	0x0d, 0x0a
	.ascii	"PASS"
	.db	0x0d, 0x0a, 0x00

msg_fail:
	.db	0x0d, 0x0a
	.ascii	"FAIL"
	.db	0x0d, 0x0a, 0x00

expected:
	.ascii	"help"
	.db	0x0d, 0x00
